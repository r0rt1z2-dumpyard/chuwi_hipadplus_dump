/dts-v1/;

/ {

	__fixups__ {
		accdet = "/fragment@1:target:0", "/fragment@45:target:0";
		apuart0 = "/fragment@2:target:0";
		audgpio = "/fragment@3:target:0";
		auxadc = "/fragment@27:target:0", "/fragment@28/__overlay__:io-channels:0";
		charger = "/fragment@5:target:0";
		chosen = "/fragment@6:target:0";
		consys = "/fragment@7:target:0";
		dsi_te = "/fragment@50:target:0";
		gpio = "/fragment@43:target:0";
		gpio_usage_mapping = "/fragment@42:target:0";
		i2c0 = "/fragment@8:target:0", "/fragment@30:target:0";
		i2c1 = "/fragment@9:target:0", "/fragment@31:target:0";
		i2c10 = "/fragment@40:target:0";
		i2c11 = "/fragment@41:target:0";
		i2c2 = "/fragment@32:target:0";
		i2c3 = "/fragment@33:target:0";
		i2c4 = "/fragment@10:target:0", "/fragment@24:target:0", "/fragment@34:target:0";
		i2c5 = "/fragment@35:target:0";
		i2c6 = "/fragment@11:target:0", "/fragment@25:target:0", "/fragment@36:target:0";
		i2c7 = "/fragment@37:target:0";
		i2c8 = "/fragment@38:target:0";
		i2c9 = "/fragment@39:target:0";
		irtx_pwm = "/fragment@12:target:0";
		kd_camera_hw1 = "/fragment@13:target:0", "/fragment@60:target:0";
		keypad = "/fragment@62:target:0";
		lk_charger = "/fragment@4:target:0";
		main_pmic = "/fragment@51:target:0";
		md1_sim1_hot_plug_eint = "/fragment@52:target:0";
		md_auxadc = "/fragment@28:target:0";
		msdc1 = "/fragment@22:target:0";
		msdc1_ins = "/fragment@44:target:0";
		mt6370_pmu = "/fragment@14:target:0";
		mt6370_typec = "/fragment@15:target:0";
		mt_pmic_vcama1_ldo_reg = "/fragment@53:target:0", "/fragment@60/__overlay__:vcama-supply:0", "/fragment@60/__overlay__:vcama_sub-supply:0";
		mt_pmic_vcama2_ldo_reg = "/fragment@54:target:0";
		mt_pmic_vcamd_ldo_reg = "/fragment@57:target:0", "/fragment@60/__overlay__:vcamd-supply:0", "/fragment@60/__overlay__:vcamd_sub-supply:0";
		mt_pmic_vcamio_ldo_reg = "/fragment@58:target:0", "/fragment@60/__overlay__:vcamio-supply:0", "/fragment@60/__overlay__:vcamio_sub-supply:0";
		mt_pmic_vldo28_ldo_reg = "/fragment@8/__overlay__/silead_touch@40:reg-tp-supply:0", "/fragment@8/__overlay__/goodix_touch@5e:reg-tp-supply:0", "/fragment@59:target:0", "/fragment@61/__overlay__:vtouch-supply:0";
		mt_pmic_vsim1_ldo_reg = "/fragment@55:target:0";
		mt_pmic_vsim2_ldo_reg = "/fragment@56:target:0";
		odm = "/fragment@0:target:0", "/fragment@16:target:0";
		otg_iddig = "/fragment@18:target:0", "/fragment@48:target:0";
		pio = "/fragment@0/__overlay__/lcm:dvdd-gpios:0", "/fragment@0/__overlay__/lcm:avdd-gpios:0", "/fragment@0/__overlay__/lcm:rst-gpios:0", "/fragment@0/__overlay__/lcm:stby-gpios:0", "/fragment@0/__overlay__/lcm:ts_rst-gpios:0", "/fragment@0/__overlay__/lcm:bl-gpios:0", "/fragment@0/__overlay__/lcm:ext_pwr-gpios:0", "/fragment@0/__overlay__/usbkeyboard:vcc_5v-gpios:0", "/fragment@0/__overlay__/usbkeyboard:dk_5v-gpios:0", "/fragment@0/__overlay__/usbkeyboard:usb_msel-gpios:0", "/fragment@0/__overlay__/intdev:hallsensor-gpios:0", "/fragment@0/__overlay__/intdev:usbkeyboard-gpios:0", "/fragment@1/__overlay__:audio_mic_en_gpio:0", "/fragment@8/__overlay__/silead_touch@40:interrupt-parent:0", "/fragment@8/__overlay__/goodix_touch@5e:interrupt-parent:0", "/fragment@8/__overlay__/focaltech_touch@38:interrupt-parent:0", "/fragment@8/__overlay__/cap_touch@41:interrupt-parent:0", "/fragment@8/__overlay__/cap_touch@41:rst-gpio:0", "/fragment@8/__overlay__/cap_touch@41:int-gpio:0", "/fragment@8/__overlay__/himax_touch@48:interrupt-parent:0", "/fragment@9/__overlay__/alsps@49:interrupt-parent:0", "/fragment@10/__overlay__/ite66121@4c:power_enable_gpio:0", "/fragment@10/__overlay__/ite66121@4c:power_5vdd_gpio:0", "/fragment@11/__overlay__/rt9465@4b:rt,en_gpio:0", "/fragment@11/__overlay__/rt9465@4b:rt,intr_gpio:0", "/fragment@14/__overlay__:mt6370,intr_gpio:0", "/fragment@15/__overlay__:mt6370pd,intr_gpio:0", "/fragment@16/__overlay__/panel@0:gpio_lcd_pwr_en:0", "/fragment@16/__overlay__/panel@0:lcd_rst_pin:0", "/fragment@16/__overlay__/ite166121_hdmi@0:hdmi_power_gpios:0", "/fragment@17:target:0", "/fragment@18/__overlay__:id-gpio:0", "/fragment@23:target:0", "/fragment@25/__overlay__/aw881xx_smartpa@36:reset-gpio:0", "/fragment@25/__overlay__/aw881xx_smartpa@37:reset-gpio:0", "/fragment@26:target:0", "/fragment@42/__overlay__:GPIO_SIM2_SIO:0", "/fragment@42/__overlay__:GPIO_SIM2_SRST:0", "/fragment@42/__overlay__:GPIO_SIM2_SCLK:0", "/fragment@42/__overlay__:GPIO_SIM1_SCLK:0", "/fragment@42/__overlay__:GPIO_SIM1_SRST:0", "/fragment@42/__overlay__:GPIO_SIM1_SIO:0", "/fragment@42/__overlay__:GPIO_SIM1_HOT_PLUG:0", "/fragment@44/__overlay__:interrupt-parent:0", "/fragment@44/__overlay__:deb-gpios:0", "/fragment@45/__overlay__:interrupt-parent:0", "/fragment@45/__overlay__:deb-gpios:0", "/fragment@46/__overlay__:interrupt-parent:0", "/fragment@47/__overlay__:interrupt-parent:0", "/fragment@48/__overlay__:interrupt-parent:0", "/fragment@49/__overlay__:interrupt-parent:0", "/fragment@50/__overlay__:interrupt-parent:0", "/fragment@51/__overlay__:interrupt-parent:0";
		pmic_clock_buffer_ctrl = "/fragment@29:target:0";
		reserved_memory = "/fragment@19:target:0";
		rt9465_slave_chr = "/fragment@46:target:0";
		scp = "/fragment@20:target:0";
		subpmic_pmu_eint = "/fragment@47:target:0";
		tcpc_pd = "/fragment@49:target:0";
		touch = "/fragment@21:target:0", "/fragment@61:target:0";
	};

	__local_fixups__ {

		fragment@0 {

			__overlay__ {

				hallsensor {
					pinctrl-0 = <0x0>;
					pinctrl-1 = <0x0>;
				};

				usbkeyboard {
					pinctrl-0 = <0x0>;
					pinctrl-1 = <0x0>;
				};
			};
		};

		fragment@12 {

			__overlay__ {
				pinctrl-0 = <0x0>;
				pinctrl-1 = <0x0>;
			};
		};

		fragment@13 {

			__overlay__ {
				pinctrl-0 = <0x0>;
				pinctrl-1 = <0x0>;
				pinctrl-10 = <0x0>;
				pinctrl-11 = <0x0>;
				pinctrl-12 = <0x0>;
				pinctrl-13 = <0x0>;
				pinctrl-14 = <0x0>;
				pinctrl-2 = <0x0>;
				pinctrl-3 = <0x0>;
				pinctrl-4 = <0x0>;
				pinctrl-5 = <0x0>;
				pinctrl-6 = <0x0>;
				pinctrl-7 = <0x0>;
				pinctrl-8 = <0x0>;
				pinctrl-9 = <0x0>;
			};
		};

		fragment@16 {

			__overlay__ {

				ite166121_hdmi@0 {
					pinctrl-0 = <0x0>;
					pinctrl-1 = <0x0>;
				};

				usb_c_pinctrl {
					pinctrl-0 = <0x0>;
					pinctrl-1 = <0x0>;
					pinctrl-10 = <0x0>;
					pinctrl-11 = <0x0>;
					pinctrl-12 = <0x0>;
					pinctrl-2 = <0x0>;
					pinctrl-3 = <0x0>;
					pinctrl-4 = <0x0>;
					pinctrl-5 = <0x0>;
					pinctrl-6 = <0x0>;
					pinctrl-7 = <0x0>;
					pinctrl-8 = <0x0>;
					pinctrl-9 = <0x0>;
				};
			};
		};

		fragment@2 {

			__overlay__ {
				pinctrl-0 = <0x0>;
				pinctrl-1 = <0x0>;
				pinctrl-2 = <0x0>;
				pinctrl-3 = <0x0>;
				pinctrl-4 = <0x0>;
			};
		};

		fragment@21 {

			__overlay__ {
				pinctrl-0 = <0x0>;
				pinctrl-1 = <0x0>;
				pinctrl-2 = <0x0>;
				pinctrl-3 = <0x0>;
				pinctrl-4 = <0x0>;
				pinctrl-5 = <0x0>;
			};
		};

		fragment@3 {

			__overlay__ {
				pinctrl-0 = <0x0>;
				pinctrl-1 = <0x0>;
				pinctrl-10 = <0x0>;
				pinctrl-11 = <0x0>;
				pinctrl-12 = <0x0>;
				pinctrl-13 = <0x0>;
				pinctrl-2 = <0x0>;
				pinctrl-3 = <0x0>;
				pinctrl-4 = <0x0>;
				pinctrl-5 = <0x0>;
				pinctrl-6 = <0x0>;
				pinctrl-7 = <0x0>;
				pinctrl-8 = <0x0>;
				pinctrl-9 = <0x0>;
			};
		};

		fragment@7 {

			__overlay__ {
				pinctrl-0 = <0x0>;
				pinctrl-1 = <0x0>;
				pinctrl-2 = <0x0>;
				pinctrl-3 = <0x0>;
			};
		};

		fragment@9 {

			__overlay__ {

				alsps@49 {
					pinctrl-0 = <0x0>;
					pinctrl-1 = <0x0>;
				};
			};
		};
	};

	__symbols__ {
		alsps_intpin_cfg = "/fragment@17/__overlay__/alspspincfg";
		alsps_intpin_default = "/fragment@17/__overlay__/alspsdefaultcfg";
		aud_clk_mosi_off = "/fragment@17/__overlay__/aud_clk_mosi_off";
		aud_clk_mosi_on = "/fragment@17/__overlay__/aud_clk_mosi_on";
		aud_dat_miso_off = "/fragment@17/__overlay__/aud_dat_miso_off";
		aud_dat_miso_on = "/fragment@17/__overlay__/aud_dat_miso_on";
		aud_dat_mosi_off = "/fragment@17/__overlay__/aud_dat_mosi_off";
		aud_dat_mosi_on = "/fragment@17/__overlay__/aud_dat_mosi_on";
		aud_pins_smartpa_off = "/fragment@17/__overlay__/aud_pins_smartpa_off";
		aud_pins_smartpa_on = "/fragment@17/__overlay__/aud_pins_smartpa_on";
		camera_main_af_mtk = "/fragment@32/__overlay__/camera_main_af@72";
		camera_main_eeprom_mtk = "/fragment@32/__overlay__/camera_main_eeprom@50";
		camera_main_mtk = "/fragment@32/__overlay__/camera_main@1a";
		camera_pins_cam0_mclk_off = "/fragment@17/__overlay__/camera_pins_cam0_mclk_off";
		camera_pins_cam0_mclk_on = "/fragment@17/__overlay__/camera_pins_cam0_mclk_on";
		camera_pins_cam0_pnd_0 = "/fragment@17/__overlay__/cam0@2";
		camera_pins_cam0_pnd_1 = "/fragment@17/__overlay__/cam0@3";
		camera_pins_cam0_rst_0 = "/fragment@17/__overlay__/cam0@0";
		camera_pins_cam0_rst_1 = "/fragment@17/__overlay__/cam0@1";
		camera_pins_cam0_vcamaf_off = "/fragment@17/__overlay__/camera_pins_cam0_vcamaf_off";
		camera_pins_cam0_vcamaf_on = "/fragment@17/__overlay__/camera_pins_cam0_vcamaf_on";
		camera_pins_cam1_mclk_off = "/fragment@17/__overlay__/camera_pins_cam1_mclk_off";
		camera_pins_cam1_mclk_on = "/fragment@17/__overlay__/camera_pins_cam1_mclk_on";
		camera_pins_cam1_pnd_0 = "/fragment@17/__overlay__/cam1@2";
		camera_pins_cam1_pnd_1 = "/fragment@17/__overlay__/cam1@3";
		camera_pins_cam1_rst_0 = "/fragment@17/__overlay__/cam1@0";
		camera_pins_cam1_rst_1 = "/fragment@17/__overlay__/cam1@1";
		camera_pins_default = "/fragment@17/__overlay__/camdefault";
		camera_sub_mtk = "/fragment@34/__overlay__/camera_sub@10";
		consys_pins_default = "/fragment@17/__overlay__/consys_default";
		ctp_pins_default = "/fragment@17/__overlay__/eint0default";
		ctp_pins_eint_as_int = "/fragment@17/__overlay__/eint@0";
		ctp_pins_eint_output0 = "/fragment@17/__overlay__/eintoutput0";
		ctp_pins_eint_output1 = "/fragment@17/__overlay__/eintoutput1";
		ctp_pins_rst_output0 = "/fragment@17/__overlay__/rstoutput0";
		ctp_pins_rst_output1 = "/fragment@17/__overlay__/rstoutput1";
		elink_hallsensor = "/fragment@0/__overlay__/hallsensor";
		elink_intdev = "/fragment@0/__overlay__/intdev";
		elink_lcm = "/fragment@0/__overlay__/lcm";
		elink_misc = "/fragment@0/__overlay__/misc";
		elink_usbkeyboard = "/fragment@0/__overlay__/usbkeyboard";
		extamp_pullhigh = "/fragment@17/__overlay__/extamp_pullhigh";
		extamp_pulllow = "/fragment@17/__overlay__/extamp_pulllow";
		gpio_redriver_c1_high = "/fragment@17/__overlay__/c1_high";
		gpio_redriver_c1_hiz = "/fragment@17/__overlay__/c1_highz";
		gpio_redriver_c1_init = "/fragment@17/__overlay__/c1_init";
		gpio_redriver_c1_low = "/fragment@17/__overlay__/c1_low";
		gpio_redriver_c2_high = "/fragment@17/__overlay__/c2_high";
		gpio_redriver_c2_hiz = "/fragment@17/__overlay__/c2_highz";
		gpio_redriver_c2_init = "/fragment@17/__overlay__/c2_init";
		gpio_redriver_c2_low = "/fragment@17/__overlay__/c2_low";
		gpio_u3_switch_disable = "/fragment@17/__overlay__/u3_sw_dis";
		gpio_u3_switch_enable = "/fragment@17/__overlay__/u3_sw_en";
		gpio_u3_switch_sel1 = "/fragment@17/__overlay__/u3_sw_sel1";
		gpio_u3_switch_sel2 = "/fragment@17/__overlay__/u3_sw_sel2";
		gpslna_pins_init = "/fragment@17/__overlay__/gpslna@0";
		gpslna_pins_oh = "/fragment@17/__overlay__/gpslna@1";
		gpslna_pins_ol = "/fragment@17/__overlay__/gpslna@2";
		hallsensor_default = "/fragment@23/__overlay__/hallsensor_default";
		hallsensor_init = "/fragment@23/__overlay__/hallsensor_init";
		hdmi_pins_funcmode = "/fragment@17/__overlay__/hdmi_pins_funcmode";
		hdmi_pins_gpiomode = "/fragment@17/__overlay__/hdmi_pins_gpiomode";
		irtx_gpio_led_default = "/fragment@17/__overlay__/irtx_gpio_led_def@gpio90";
		irtx_gpio_led_set = "/fragment@17/__overlay__/irtx_gpio_led_set@gpio90";
		ite166121_hdmi = "/fragment@16/__overlay__/ite166121_hdmi@0";
		led0 = "/fragment@16/__overlay__/led@0";
		led1 = "/fragment@16/__overlay__/led@1";
		led2 = "/fragment@16/__overlay__/led@2";
		led3 = "/fragment@16/__overlay__/led@3";
		led4 = "/fragment@16/__overlay__/led@4";
		led5 = "/fragment@16/__overlay__/led@5";
		led6 = "/fragment@16/__overlay__/led@6";
		nfc_mtk = "/fragment@33/__overlay__/nfc@08";
		panel = "/fragment@16/__overlay__/panel@0";
		slave_charger_mtk = "/fragment@36/__overlay__/slave_charger@4b";
		subpmic_pmu_mtk = "/fragment@35/__overlay__/subpmic_pmu@34";
		uart0_gpio_def_cfg = "/fragment@17/__overlay__/uart0gpiodefault";
		uart0_rx_clr_cfg = "/fragment@17/__overlay__/uart0_rx_clear@gpio95";
		uart0_rx_set_cfg = "/fragment@17/__overlay__/uart0_rx_set@gpio95";
		uart0_tx_clr_cfg = "/fragment@17/__overlay__/uart0_tx_clear@gpio96";
		uart0_tx_set_cfg = "/fragment@17/__overlay__/uart0_tx_set@gpio96";
		usb_c_pinctrl = "/fragment@16/__overlay__/usb_c_pinctrl";
		usb_default = "/fragment@17/__overlay__/usb_default";
		usb_type_c_mtk = "/fragment@35/__overlay__/usb_type_c@4e";
		usbkeyboard_default = "/fragment@26/__overlay__/usbkeyboard_default";
		usbkeyboard_init = "/fragment@26/__overlay__/usbkeyboard_init";
		vibrator0 = "/fragment@16/__overlay__/vibrator@0";
		vow_clk_miso_off = "/fragment@17/__overlay__/vow_clk_miso_off";
		vow_clk_miso_on = "/fragment@17/__overlay__/vow_clk_miso_on";
		vow_dat_miso_off = "/fragment@17/__overlay__/vow_dat_miso_off";
		vow_dat_miso_on = "/fragment@17/__overlay__/vow_dat_miso_on";
	};

	fragment@0 {
		target = <0xffffffff>;

		__overlay__ {

			hallsensor {
				compatible = "elink,hallsensor";
				phandle = <0x48>;
				pinctrl-0 = <0x3>;
				pinctrl-1 = <0x4>;
				pinctrl-names = "hallsensor_default", "hallsensor_init";
				status = "okay";
			};

			intdev {
				compatible = "elink,intdev";
				hallsensor-gpios = <0xffffffff 0x2 0x0>;
				hallsensor_debounce = <0xfa00>;
				hallsensor_flag = <0x8>;
				phandle = <0x47>;
				status = "okay";
				usbkeyboard-gpios = <0xffffffff 0x18 0x0>;
				usbkeyboard_debounce = <0xfa00>;
				usbkeyboard_flag = <0x8>;
			};

			lcm {
				avdd = <0x38 0x0>;
				avdd-gpios = <0xffffffff 0x38 0x0>;
				bl = <0x10 0x0>;
				bl-gpios = <0xffffffff 0x10 0x0>;
				bl_coef = <0x5a>;
				compatible = "elink,lcm";
				dvdd = <0x37 0x0>;
				dvdd-gpios = <0xffffffff 0x37 0x0>;
				ext_pwr = <0x56 0x0>;
				ext_pwr-gpios = <0xffffffff 0x56 0x0>;
				phandle = <0x44>;
				rst = <0x2d 0x0>;
				rst-gpios = <0xffffffff 0x2d 0x0>;
				stby = <0x2c 0x0>;
				stby-gpios = <0xffffffff 0x2c 0x0>;
				ts_rst = <0x9e 0x0>;
				ts_rst-gpios = <0xffffffff 0x9e 0x0>;
			};

			misc {
				compatible = "elink,misc";
				phandle = <0x45>;
			};

			usbkeyboard {
				compatible = "elink,usbkeyboard";
				dk_5v-gpios = <0xffffffff 0x19 0x0>;
				phandle = <0x46>;
				pinctrl-0 = <0x1>;
				pinctrl-1 = <0x2>;
				pinctrl-names = "usbkeyboard_default", "usbkeyboard_init";
				status = "okay";
				usb_msel-gpios = <0xffffffff 0x4e 0x0>;
				vcc_5v-gpios = <0xffffffff 0x35 0x0>;
			};
		};
	};

	fragment@1 {
		target = <0xffffffff>;

		__overlay__ {
			accdet-mic-mode = <0x1>;
			accdet-mic-vol = <0x6>;
			accdet-plugout-debounce = <0x1>;
			audio_mic_en_gpio = <0xffffffff 0xd 0x0>;
			headset-eint-level-pol = <0x8>;
			headset-four-key-threshold = <0x0 0x3a 0x79 0xc0 0x190>;
			headset-mode-setting = <0x500 0x500 0x1 0x1f0 0x800 0x800 0x20 0x44>;
			headset-three-key-threshold = <0x0 0x50 0xdc 0x190>;
			headset-three-key-threshold-CDD = <0x0 0x79 0xc0 0x258>;
			status = "okay";
		};
	};

	fragment@10 {
		target = <0xffffffff>;

		__overlay__ {

			ite66121@4c {
				compatible = "ite,it66121-i2c";
				power_5vdd_gpio = <0xffffffff 0x35 0x0>;
				power_enable_gpio = <0xffffffff 0x36 0x0>;
				reg = <0x4c>;
				status = "okay";
			};
		};
	};

	fragment@11 {
		target = <0xffffffff>;

		__overlay__ {

			rt9465@4b {
				charger_name = "secondary_chg";
				compatible = "richtek,rt9465";
				cv = <0x456d70>;
				en_st;
				en_wdt;
				ichg = <0x16e360>;
				ieoc = <0xaae60>;
				interrupt-names = "wdtmri";
				mivr = <0x44aa20>;
				mt6306_en_pin = <0x1>;
				reg = <0x4b>;
				rt,en_gpio = <0xffffffff 0xb3 0x0>;
				rt,en_gpio_num = <0xb3>;
				rt,intr_gpio = <0xffffffff 0x9 0x0>;
				rt,intr_gpio_num = <0x9>;
				safety_timer = <0xc>;
				status = "okay";
			};
		};
	};

	fragment@12 {
		target = <0xffffffff>;

		__overlay__ {
			pinctrl-0 = <0x1e>;
			pinctrl-1 = <0x1f>;
			pinctrl-names = "irtx_gpio_led_default", "irtx_gpio_led_set";
			status = "okay";
		};
	};

	fragment@13 {
		target = <0xffffffff>;

		__overlay__ {
			pinctrl-0 = <0x20>;
			pinctrl-1 = <0x21>;
			pinctrl-10 = <0x2a>;
			pinctrl-11 = <0x2b>;
			pinctrl-12 = <0x2c>;
			pinctrl-13 = <0x2d>;
			pinctrl-14 = <0x2e>;
			pinctrl-2 = <0x22>;
			pinctrl-3 = <0x23>;
			pinctrl-4 = <0x24>;
			pinctrl-5 = <0x25>;
			pinctrl-6 = <0x26>;
			pinctrl-7 = <0x27>;
			pinctrl-8 = <0x28>;
			pinctrl-9 = <0x29>;
			pinctrl-names = "default", "cam0_rst0", "cam0_rst1", "cam0_pnd0", "cam0_pnd1", "cam1_rst0", "cam1_rst1", "cam1_pnd0", "cam1_pnd1", "cam0_mclk_off", "cam0_mclk_on", "cam1_mclk_off", "cam1_mclk_on", "cam_ldo_vcamaf_1", "cam_ldo_vcamaf_0";
			status = "okay";
		};
	};

	fragment@14 {
		target = <0xffffffff>;

		__overlay__ {
			mt6370,intr_gpio = <0xffffffff 0xa 0x0>;
			mt6370,intr_gpio_num = <0xa>;
		};
	};

	fragment@15 {
		target = <0xffffffff>;

		__overlay__ {
			mt6370pd,intr_gpio = <0xffffffff 0x29 0x0>;
			mt6370pd,intr_gpio_num = <0x29>;
		};
	};

	fragment@16 {
		target = <0xffffffff>;

		__overlay__ {

			ite166121_hdmi@0 {
				compatible = "mediatek,mt8168-hdmitx";
				hdmi_power_gpios = <0xffffffff 0xb0 0x0>;
				mediatek,hdmi_bridgeic_port = <0x4>;
				phandle = <0x53>;
				pinctrl-0 = <0x3c>;
				pinctrl-1 = <0x3d>;
				pinctrl-names = "hdmi_poweron", "hdmi_poweroff";
				status = "okay";
			};

			led@0 {
				compatible = "mediatek,red";
				data = <0x1>;
				led_mode = <0x0>;
				phandle = <0x49>;
				pwm_config = <0x0 0x0 0x0 0x0 0x0>;
			};

			led@1 {
				compatible = "mediatek,green";
				data = <0x1>;
				led_mode = <0x0>;
				phandle = <0x4a>;
				pwm_config = <0x0 0x0 0x0 0x0 0x0>;
			};

			led@2 {
				compatible = "mediatek,blue";
				data = <0x1>;
				led_mode = <0x0>;
				phandle = <0x4b>;
				pwm_config = <0x0 0x0 0x0 0x0 0x0>;
			};

			led@3 {
				compatible = "mediatek,jogball-backlight";
				data = <0x1>;
				led_mode = <0x0>;
				phandle = <0x4c>;
				pwm_config = <0x0 0x0 0x0 0x0 0x0>;
			};

			led@4 {
				compatible = "mediatek,keyboard-backlight";
				data = <0x1>;
				led_mode = <0x0>;
				phandle = <0x4d>;
				pwm_config = <0x0 0x0 0x0 0x0 0x0>;
			};

			led@5 {
				compatible = "mediatek,button-backlight";
				data = <0x1>;
				led_mode = <0x0>;
				phandle = <0x4e>;
				pwm_config = <0x0 0x0 0x0 0x0 0x0>;
			};

			led@6 {
				compatible = "mediatek,lcd-backlight";
				data = <0x1>;
				led_mode = <0x5>;
				phandle = <0x4f>;
				pwm_config = <0x4 0x0 0x0 0x0 0x0>;
			};

			panel@0 {
				compatible = "es,es6311_anx6585_zigzag_wxga";
				gpio_lcd_pwr_en = <0xffffffff 0x37 0x0>;
				lcd_rst_pin = <0xffffffff 0x2d 0x0>;
				phandle = <0x50>;
				status = "disabled";
			};

			usb_c_pinctrl {
				compatible = "mediatek,usb_c_pinctrl";
				phandle = <0x52>;
				pinctrl-0 = <0x2f>;
				pinctrl-1 = <0x30>;
				pinctrl-10 = <0x39>;
				pinctrl-11 = <0x3a>;
				pinctrl-12 = <0x3b>;
				pinctrl-2 = <0x31>;
				pinctrl-3 = <0x32>;
				pinctrl-4 = <0x33>;
				pinctrl-5 = <0x34>;
				pinctrl-6 = <0x35>;
				pinctrl-7 = <0x36>;
				pinctrl-8 = <0x37>;
				pinctrl-9 = <0x38>;
				pinctrl-names = "usb_default", "redrv_c1_init", "redrv_c1_low", "redrv_c1_hiz", "redrv_c1_high", "redrv_c2_init", "redrv_c2_low", "redrv_c2_hiz", "redrv_c2_high", "switch_sel1", "switch_sel2", "switch_enable", "switch_disable";
				status = "okay";

				usb_switch-data {
					c1_pin_num = <0xa6>;
					c1_pin_val = <0x2>;
					c2_pin_num = <0xb2>;
					c2_pin_val = <0x2>;
					en_pin_num = <0x6c>;
					en_pin_val = <0x0>;
					sel_pin_num = <0x6f>;
					sel_pin_val = <0x1>;
				};
			};

			vibrator@0 {
				compatible = "mediatek,vibrator";
				phandle = <0x51>;
				vib_limit = <0x9>;
				vib_timer = <0x19>;
				vib_vol = <0x9>;
			};
		};
	};

	fragment@17 {
		target = <0xffffffff>;

		__overlay__ {

			alspsdefaultcfg {
				phandle = <0x1c>;
			};

			alspspincfg {
				phandle = <0x1d>;

				pins_cmd_dat {
					bias-pull-up = <0x0>;
					pinmux = <0x600>;
					slew-rate = <0x0>;
				};
			};

			aud_clk_mosi_off {
				phandle = <0xa>;

				pins_cmd0_dat {
					pinmux = <0x8800>;
				};
			};

			aud_clk_mosi_on {
				phandle = <0xb>;

				pins_cmd0_dat {
					pinmux = <0x8801>;
				};
			};

			aud_dat_miso_off {
				phandle = <0xe>;

				pins_cmd1_dat {
					pinmux = <0x8e00>;
				};

				pins_cmd2_dat {
					pinmux = <0x8f00>;
				};
			};

			aud_dat_miso_on {
				phandle = <0xf>;

				pins_cmd1_dat {
					pinmux = <0x8e01>;
				};

				pins_cmd2_dat {
					pinmux = <0x8f01>;
				};
			};

			aud_dat_mosi_off {
				phandle = <0xc>;

				pins_cmd1_dat {
					pinmux = <0x8a00>;
				};

				pins_cmd2_dat {
					pinmux = <0x8b00>;
				};
			};

			aud_dat_mosi_on {
				phandle = <0xd>;

				pins_cmd1_dat {
					pinmux = <0x8a01>;
				};

				pins_cmd2_dat {
					pinmux = <0x8b01>;
				};
			};

			aud_pins_smartpa_off {
				phandle = <0x10>;

				pins_cmd0_dat {
					pinmux = <0xae00>;
				};
			};

			aud_pins_smartpa_on {
				phandle = <0x11>;

				pins_cmd0_dat {
					pinmux = <0xae02>;
				};
			};

			c1_high {
				phandle = <0x33>;

				pins_cmd_dat {
					output-high;
					pinmux = <0xa600>;
					slew-rate = <0x1>;
				};
			};

			c1_highz {
				phandle = <0x32>;

				pins_cmd_dat {
					bias-disable;
					pinmux = <0xa600>;
					slew-rate = <0x0>;
				};
			};

			c1_init {
				phandle = <0x30>;

				pins_cmd_dat {
					output-low;
					pinmux = <0xa600>;
					slew-rate = <0x1>;
				};
			};

			c1_low {
				phandle = <0x31>;

				pins_cmd_dat {
					output-low;
					pinmux = <0xa600>;
					slew-rate = <0x1>;
				};
			};

			c2_high {
				phandle = <0x37>;

				pins_cmd_dat {
					output-high;
					pinmux = <0xb200>;
					slew-rate = <0x1>;
				};
			};

			c2_highz {
				phandle = <0x36>;

				pins_cmd_dat {
					bias-disable;
					pinmux = <0xb200>;
					slew-rate = <0x0>;
				};
			};

			c2_init {
				phandle = <0x34>;

				pins_cmd_dat {
					output-low;
					pinmux = <0xb200>;
					slew-rate = <0x1>;
				};
			};

			c2_low {
				phandle = <0x35>;

				pins_cmd_dat {
					output-low;
					pinmux = <0xb200>;
					slew-rate = <0x1>;
				};
			};

			cam0@0 {
				phandle = <0x21>;

				pins_cmd_dat {
					output-low;
					pinmux = <0x6500>;
					slew-rate = <0x1>;
				};
			};

			cam0@1 {
				phandle = <0x22>;

				pins_cmd_dat {
					output-high;
					pinmux = <0x6500>;
					slew-rate = <0x1>;
				};
			};

			cam0@2 {
				phandle = <0x23>;

				pins_cmd_dat {
					output-low;
					pinmux = <0x6100>;
					slew-rate = <0x1>;
				};
			};

			cam0@3 {
				phandle = <0x24>;

				pins_cmd_dat {
					output-high;
					pinmux = <0x6100>;
					slew-rate = <0x1>;
				};
			};

			cam1@0 {
				phandle = <0x25>;

				pins_cmd_dat {
					output-low;
					pinmux = <0x6600>;
					slew-rate = <0x1>;
				};
			};

			cam1@1 {
				phandle = <0x26>;

				pins_cmd_dat {
					output-high;
					pinmux = <0x6600>;
					slew-rate = <0x1>;
				};
			};

			cam1@2 {
				phandle = <0x27>;

				pins_cmd_dat {
					output-low;
					pinmux = <0x6200>;
					slew-rate = <0x1>;
				};
			};

			cam1@3 {
				phandle = <0x28>;

				pins_cmd_dat {
					output-high;
					pinmux = <0x6200>;
					slew-rate = <0x1>;
				};
			};

			camdefault {
				phandle = <0x20>;
			};

			camera_pins_cam0_mclk_off {
				phandle = <0x29>;

				pins_cmd_dat {
					pinmux = <0x6300>;
				};
			};

			camera_pins_cam0_mclk_on {
				phandle = <0x2a>;

				pins_cmd_dat {
					pinmux = <0x6301>;
				};
			};

			camera_pins_cam0_vcamaf_off {
				phandle = <0x2e>;

				pins_cmd_dat {
					output-low;
					pinmux = <0xa900>;
					slew-rate = <0x1>;
				};
			};

			camera_pins_cam0_vcamaf_on {
				phandle = <0x2d>;

				pins_cmd_dat {
					output-high;
					pinmux = <0xa900>;
					slew-rate = <0x1>;
				};
			};

			camera_pins_cam1_mclk_off {
				phandle = <0x2b>;

				pins_cmd_dat {
					pinmux = <0x6300>;
				};
			};

			camera_pins_cam1_mclk_on {
				phandle = <0x2c>;

				pins_cmd_dat {
					pinmux = <0x6301>;
				};
			};

			consys_default {
				phandle = <0x18>;
			};

			eint0default {
				phandle = <0x3e>;
			};

			eint@0 {
				phandle = <0x3f>;

				pins_cmd_dat {
					bias-disable;
					pinmux = <0x100>;
					slew-rate = <0x0>;
				};
			};

			eintoutput0 {
				phandle = <0x40>;

				pins_cmd_dat {
					output-low;
					pinmux = <0x100>;
					slew-rate = <0x1>;
				};
			};

			eintoutput1 {
				phandle = <0x41>;

				pins_cmd_dat {
					output-high;
					pinmux = <0x100>;
					slew-rate = <0x1>;
				};
			};

			extamp_pullhigh {
				phandle = <0x16>;

				pins_cmd_dat {
					output-high;
					pinmux = <0x4500>;
					slew-rate = <0x1>;
				};
			};

			extamp_pulllow {
				phandle = <0x17>;

				pins_cmd_dat {
					output-low;
					pinmux = <0x4500>;
					slew-rate = <0x1>;
				};
			};

			gpslna@0 {
				phandle = <0x19>;

				pins_cmd_dat {
					bias-disable;
					output-low;
					pinmux = <0x9b00>;
					slew-rate = <0x0>;
				};
			};

			gpslna@1 {
				phandle = <0x1a>;

				pins_cmd_dat {
					output-high;
					pinmux = <0x9b00>;
					slew-rate = <0x1>;
				};
			};

			gpslna@2 {
				phandle = <0x1b>;

				pins_cmd_dat {
					output-low;
					pinmux = <0x9b00>;
					slew-rate = <0x1>;
				};
			};

			hdmi_pins_funcmode {
				phandle = <0x3c>;

				pins_cmd_dat {
					pinmux = <0x3201 0x3301 0xaa01 0xab01 0xac01 0xd01 0xe01 0xf01 0x1001 0x1101 0x1201 0x1301 0x1401 0x1501 0x1601 0x1701 0x1801 0x1901 0x1a01 0x1b01 0x1c01>;
				};
			};

			hdmi_pins_gpiomode {
				phandle = <0x3d>;

				pins_cmd_dat {
					pinmux = <0xaa00 0xab00 0xac00 0xd00 0xe00 0xf00 0x1000 0x1100 0x1200 0x1300 0x1400 0x1500 0x1600 0x1700 0x1800 0x1900 0x1a00 0x1b00 0x1c00>;
				};
			};

			irtx_gpio_led_def@gpio90 {
				phandle = <0x1e>;

				pins_cmd_dat {
					bias-disable;
					input-schmitt-enable = <0x0>;
					output-low;
					pinmux = <0x5a00>;
					slew-rate = <0x1>;
				};
			};

			irtx_gpio_led_set@gpio90 {
				phandle = <0x1f>;

				pins_cmd_dat {
					output-high;
					pinmux = <0x5a01>;
					slew-rate = <0x1>;
				};
			};

			rstoutput0 {
				phandle = <0x42>;

				pins_cmd_dat {
					output-low;
					pinmux = <0x9e00>;
					slew-rate = <0x1>;
				};
			};

			rstoutput1 {
				phandle = <0x43>;

				pins_cmd_dat {
					output-high;
					pinmux = <0x9e00>;
					slew-rate = <0x1>;
				};
			};

			u3_sw_dis {
				phandle = <0x3b>;

				pins_cmd_dat {
					output-high;
					pinmux = <0x6c00>;
					slew-rate = <0x1>;
				};
			};

			u3_sw_en {
				phandle = <0x3a>;

				pins_cmd_dat {
					output-low;
					pinmux = <0x6c00>;
					slew-rate = <0x1>;
				};
			};

			u3_sw_sel1 {
				phandle = <0x38>;

				pins_cmd_dat {
					output-low;
					pinmux = <0x6f00>;
					slew-rate = <0x1>;
				};
			};

			u3_sw_sel2 {
				phandle = <0x39>;

				pins_cmd_dat {
					output-high;
					pinmux = <0x6f00>;
					slew-rate = <0x1>;
				};
			};

			uart0_rx_clear@gpio95 {
				phandle = <0x7>;

				pins_cmd_dat {
					output-high;
					pinmux = <0x5f00>;
					slew-rate = <0x1>;
				};
			};

			uart0_rx_set@gpio95 {
				phandle = <0x6>;

				pins_cmd_dat {
					pinmux = <0x5f01>;
				};
			};

			uart0_tx_clear@gpio96 {
				phandle = <0x9>;

				pins_cmd_dat {
					output-high;
					pinmux = <0x6000>;
					slew-rate = <0x1>;
				};
			};

			uart0_tx_set@gpio96 {
				phandle = <0x8>;

				pins_cmd_dat {
					pinmux = <0x6001>;
				};
			};

			uart0gpiodefault {
				phandle = <0x5>;
			};

			usb_default {
				phandle = <0x2f>;
			};

			vow_clk_miso_off {
				phandle = <0x14>;

				pins_cmd3_dat {
					pinmux = <0x8f00>;
				};
			};

			vow_clk_miso_on {
				phandle = <0x15>;

				pins_cmd3_dat {
					pinmux = <0x8f04>;
				};
			};

			vow_dat_miso_off {
				phandle = <0x12>;

				pins_cmd1_dat {
					pinmux = <0x8e00>;
				};
			};

			vow_dat_miso_on {
				phandle = <0x13>;

				pins_cmd1_dat {
					pinmux = <0x8e04>;
				};
			};
		};
	};

	fragment@18 {
		target = <0xffffffff>;

		__overlay__ {
			id-gpio = <0xffffffff 0x29 0x0>;
		};
	};

	fragment@19 {
		target = <0xffffffff>;

		__overlay__ {
			#address-cells = <0x2>;
			#size-cells = <0x2>;
			ranges;

			zmc-default {
				alignment = <0x0 0x10000000>;
				alloc-ranges = <0x0 0xc0000000 0x1 0x0>;
				compatible = "mediatek,zone_movable_cma";
				size = <0x0 0xffc00000>;
			};
		};
	};

	fragment@2 {
		target = <0xffffffff>;

		__overlay__ {
			pinctrl-0 = <0x5>;
			pinctrl-1 = <0x6>;
			pinctrl-2 = <0x7>;
			pinctrl-3 = <0x8>;
			pinctrl-4 = <0x9>;
			pinctrl-names = "uart0_gpio_default", "uart0_rx_set", "uart0_rx_clear", "uart0_tx_set", "uart0_tx_clear";
			status = "okay";
		};
	};

	fragment@20 {
		target = <0xffffffff>;

		__overlay__ {
			core_1 = "enable";
			scp_sramSize = <0x80000>;
		};
	};

	fragment@21 {
		target = <0xffffffff>;

		__overlay__ {
			compatible = "elink,touch";
			pinctrl-0 = <0x3e>;
			pinctrl-1 = <0x3f>;
			pinctrl-2 = <0x40>;
			pinctrl-3 = <0x41>;
			pinctrl-4 = <0x42>;
			pinctrl-5 = <0x43>;
			pinctrl-names = "default", "state_eint_as_int", "state_eint_output0", "state_eint_output1", "state_rst_output0", "state_rst_output1";
			status = "okay";
			tpd-filter-custom-prameters = <0x0 0x0 0x0 0x0 0x0 0x0 0x0 0x0 0x0 0x0 0x0 0x0>;
			tpd-filter-custom-speed = <0x0 0x0 0x0>;
			tpd-filter-enable = <0x1>;
			tpd-filter-pixel-density = <0x92>;
			tpd-key-dim-local = <0x5a 0x373 0x64 0x28 0xe6 0x373 0x64 0x28 0x172 0x373 0x64 0x28 0x0 0x0 0x0 0x0>;
			tpd-key-local = <0x8b 0xac 0x9e 0x0>;
			tpd-key-num = <0x3>;
			tpd-max-touch-num = <0x5>;
			tpd-resolution = <0x320 0x500>;
			use-tpd-button = <0x0>;
		};
	};

	fragment@22 {
		target = <0xffffffff>;

		__overlay__ {
			cd_level = [00];
			status = "okay";
		};
	};

	fragment@23 {
		target = <0xffffffff>;

		__overlay__ {

			hallsensor_default {
				phandle = <0x3>;
			};

			hallsensor_init {
				phandle = <0x4>;

				pins_cmd_dat {
					bias-pull-up = <0x65>;
					input-enable;
					pinmux = <0x200>;
					slew-rate = <0x0>;
				};
			};
		};
	};

	fragment@24 {
		target = <0xffffffff>;

		__overlay__ {

			it6112@56 {
				compatible = "mediatek,i2c_lcd_bias";
				reg = <0x56>;
				status = "okay";
			};
		};
	};

	fragment@25 {
		target = <0xffffffff>;

		__overlay__ {

			aw881xx_smartpa@36 {
				compatible = "awinic,aw881xx_smartpa";
				fade-enable = <0x0>;
				monitor-flag = <0x1>;
				pa-syn-enable = <0x0>;
				reg = <0x36>;
				reset-gpio = <0xffffffff 0xa3 0x0>;
				sound-channel = <0x0>;
				status = "okay";
			};

			aw881xx_smartpa@37 {
				compatible = "awinic,aw881xx_smartpa";
				fade-enable = <0x0>;
				monitor-flag = <0x1>;
				pa-syn-enable = <0x0>;
				reg = <0x37>;
				reset-gpio = <0xffffffff 0xa1 0x0>;
				sound-channel = <0x1>;
				status = "okay";
			};
		};
	};

	fragment@26 {
		target = <0xffffffff>;

		__overlay__ {

			usbkeyboard_default {
				phandle = <0x1>;
			};

			usbkeyboard_init {
				phandle = <0x2>;

				pins_cmd2_dat {
					output-low;
					pinmux = <0x1900>;
					slew-rate = <0x1>;
				};

				pins_cmd_dat {
					bias-pull-up = <0x65>;
					input-enable;
					pinmux = <0x1800>;
					slew-rate = <0x0>;
				};
			};
		};
	};

	fragment@27 {
		target = <0xffffffff>;

		__overlay__ {

			adc_channel@ {
				compatible = "mediatek,adc_channel";
				mediatek,adc_fdd_rf_params_dynamic_custom_ch = <0x2>;
				mediatek,temperature0 = <0x0>;
				mediatek,temperature1 = <0x1>;
				status = "okay";
			};
		};
	};

	fragment@28 {
		target = <0xffffffff>;

		__overlay__ {
			io-channels = <0xffffffff 0x2>;
		};
	};

	fragment@29 {
		target = <0xffffffff>;

		__overlay__ {
			mediatek,clkbuf-config = <0x2 0x1 0x0 0x2 0x0 0x0 0x1>;
			mediatek,clkbuf-driving-current = <0xffffffff 0xffffffff 0xffffffff 0xffffffff 0xffffffff 0xffffffff 0xffffffff>;
			mediatek,clkbuf-quantity = <0x7>;
			status = "okay";
		};
	};

	fragment@3 {
		target = <0xffffffff>;

		__overlay__ {
			pinctrl-0 = <0xa>;
			pinctrl-1 = <0xb>;
			pinctrl-10 = <0x14>;
			pinctrl-11 = <0x15>;
			pinctrl-12 = <0x16>;
			pinctrl-13 = <0x17>;
			pinctrl-2 = <0xc>;
			pinctrl-3 = <0xd>;
			pinctrl-4 = <0xe>;
			pinctrl-5 = <0xf>;
			pinctrl-6 = <0x10>;
			pinctrl-7 = <0x11>;
			pinctrl-8 = <0x12>;
			pinctrl-9 = <0x13>;
			pinctrl-names = "aud_clk_mosi_off", "aud_clk_mosi_on", "aud_dat_mosi_off", "aud_dat_mosi_on", "aud_dat_miso_off", "aud_dat_miso_on", "aud_smartpa_off", "aud_smartpa_on", "vow_dat_miso_off", "vow_dat_miso_on", "vow_clk_miso_off", "vow_clk_miso_on", "extamp-pullhigh", "extamp-pulllow";
			status = "okay";
		};
	};

	fragment@30 {
		target = <0xffffffff>;

		__overlay__ {
			#address-cells = <0x1>;
			#size-cells = <0x0>;
			clock-frequency = <0x61a80>;
			mediatek,use-open-drain;
		};
	};

	fragment@31 {
		target = <0xffffffff>;

		__overlay__ {
			#address-cells = <0x1>;
			#size-cells = <0x0>;
			clock-frequency = <0x61a80>;
			mediatek,use-open-drain;
		};
	};

	fragment@32 {
		target = <0xffffffff>;

		__overlay__ {
			#address-cells = <0x1>;
			#size-cells = <0x0>;
			clock-frequency = <0x61a80>;
			mediatek,use-open-drain;

			camera_main@1a {
				compatible = "mediatek,camera_main";
				phandle = <0x54>;
				reg = <0x1a>;
				status = "okay";
			};

			camera_main_af@72 {
				compatible = "mediatek,camera_main_af";
				phandle = <0x55>;
				reg = <0x72>;
				status = "okay";
			};

			camera_main_eeprom@50 {
				compatible = "mediatek,camera_main_eeprom";
				phandle = <0x56>;
				reg = <0x50>;
				status = "okay";
			};
		};
	};

	fragment@33 {
		target = <0xffffffff>;

		__overlay__ {
			#address-cells = <0x1>;
			#size-cells = <0x0>;
			clock-frequency = <0x61a80>;
			mediatek,use-open-drain;

			nfc@08 {
				compatible = "mediatek,nfc";
				phandle = <0x57>;
				reg = <0x8>;
				status = "okay";
			};
		};
	};

	fragment@34 {
		target = <0xffffffff>;

		__overlay__ {
			#address-cells = <0x1>;
			#size-cells = <0x0>;
			clock-frequency = <0x61a80>;
			mediatek,use-open-drain;

			camera_sub@10 {
				compatible = "mediatek,camera_sub";
				phandle = <0x58>;
				reg = <0x10>;
				status = "okay";
			};
		};
	};

	fragment@35 {
		target = <0xffffffff>;

		__overlay__ {
			#address-cells = <0x1>;
			#size-cells = <0x0>;
			clock-frequency = <0x33e140>;
			mediatek,use-push-pull;

			subpmic_pmu@34 {
				compatible = "mediatek,subpmic_pmu";
				phandle = <0x5a>;
				reg = <0x34>;
				status = "okay";
			};

			usb_type_c@4e {
				compatible = "mediatek,usb_type_c";
				phandle = <0x59>;
				reg = <0x4e>;
				status = "okay";
			};
		};
	};

	fragment@36 {
		target = <0xffffffff>;

		__overlay__ {
			#address-cells = <0x1>;
			#size-cells = <0x0>;
			clock-frequency = <0x61a80>;
			mediatek,use-open-drain;

			slave_charger@4b {
				compatible = "mediatek,slave_charger";
				phandle = <0x5b>;
				reg = <0x4b>;
				status = "okay";
			};
		};
	};

	fragment@37 {
		target = <0xffffffff>;

		__overlay__ {
			#address-cells = <0x1>;
			#size-cells = <0x0>;
			clock-frequency = <0x61a80>;
			mediatek,use-open-drain;
		};
	};

	fragment@38 {
		target = <0xffffffff>;

		__overlay__ {
			#address-cells = <0x1>;
			#size-cells = <0x0>;
			clock-frequency = <0x61a80>;
			mediatek,use-open-drain;
		};
	};

	fragment@39 {
		target = <0xffffffff>;

		__overlay__ {
			#address-cells = <0x1>;
			#size-cells = <0x0>;
			clock-frequency = <0x61a80>;
			mediatek,use-open-drain;
		};
	};

	fragment@4 {
		target = <0xffffffff>;

		__overlay__ {
			ac_charger_current = <0x155cc0>;
			ac_charger_input_current = <0x1e8480>;
		};
	};

	fragment@40 {
		target = <0xffffffff>;

		__overlay__ {
			#address-cells = <0x1>;
			#size-cells = <0x0>;
			clock-frequency = <0x61a80>;
			mediatek,use-open-drain;
		};
	};

	fragment@41 {
		target = <0xffffffff>;

		__overlay__ {
			#address-cells = <0x1>;
			#size-cells = <0x0>;
			clock-frequency = <0x61a80>;
			mediatek,use-open-drain;
		};
	};

	fragment@42 {
		target = <0xffffffff>;

		__overlay__ {
			GPIO_SIM1_HOT_PLUG = <0xffffffff 0x2f 0x0>;
			GPIO_SIM1_SCLK = <0xffffffff 0x26 0x0>;
			GPIO_SIM1_SIO = <0xffffffff 0x28 0x0>;
			GPIO_SIM1_SRST = <0xffffffff 0x27 0x0>;
			GPIO_SIM2_SCLK = <0xffffffff 0x25 0x0>;
			GPIO_SIM2_SIO = <0xffffffff 0x23 0x0>;
			GPIO_SIM2_SRST = <0xffffffff 0x24 0x0>;
		};
	};

	fragment@43 {
		target = <0xffffffff>;

		__overlay__ {
			gpio_init_default = <0x0 0x0 0x0 0x0 0x1 0x1 0x1 0x1 0x0 0x0 0x0 0x0 0x0 0x1 0x2 0x0 0x0 0x0 0x1 0x1 0x1 0x3 0x0 0x0 0x0 0x1 0x1 0x1 0x4 0x0 0x0 0x0 0x1 0x0 0x0 0x5 0x0 0x0 0x0 0x1 0x0 0x0 0x6 0x0 0x0 0x0 0x1 0x0 0x0 0x7 0x0 0x0 0x0 0x1 0x1 0x0 0x8 0x0 0x0 0x0 0x1 0x0 0x0 0x9 0x0 0x0 0x0 0x1 0x1 0x0 0xa 0x0 0x0 0x0 0x1 0x1 0x0 0xb 0x3 0x0 0x0 0x1 0x1 0x0 0xc 0x3 0x0 0x0 0x1 0x1 0x0 0xd 0x0 0x0 0x0 0x1 0x0 0x0 0xe 0x0 0x0 0x0 0x1 0x0 0x0 0xf 0x0 0x0 0x0 0x1 0x0 0x0 0x10 0x0 0x0 0x0 0x1 0x0 0x0 0x11 0x0 0x0 0x0 0x1 0x0 0x0 0x12 0x0 0x0 0x0 0x1 0x0 0x0 0x13 0x0 0x0 0x0 0x1 0x0 0x0 0x14 0x0 0x0 0x0 0x1 0x0 0x0 0x15 0x0 0x0 0x0 0x1 0x0 0x0 0x16 0x0 0x0 0x0 0x1 0x0 0x0 0x17 0x0 0x0 0x0 0x1 0x0 0x0 0x18 0x0 0x0 0x0 0x1 0x1 0x0 0x19 0x0 0x0 0x0 0x1 0x0 0x0 0x1a 0x0 0x0 0x0 0x1 0x0 0x0 0x1b 0x0 0x0 0x0 0x1 0x0 0x0 0x1c 0x0 0x0 0x0 0x1 0x0 0x0 0x1d 0x1 0x1 0x0 0x0 0x0 0x0 0x1e 0x1 0x0 0x0 0x1 0x1 0x0 0x1f 0x1 0x0 0x0 0x1 0x1 0x0 0x20 0x1 0x0 0x0 0x1 0x1 0x0 0x21 0x1 0x0 0x0 0x1 0x1 0x0 0x22 0x1 0x0 0x0 0x1 0x1 0x0 0x23 0x1 0x0 0x0 0x1 0x1 0x0 0x24 0x1 0x1 0x0 0x0 0x0 0x0 0x25 0x1 0x1 0x0 0x0 0x0 0x0 0x26 0x1 0x1 0x0 0x0 0x0 0x0 0x27 0x1 0x1 0x0 0x0 0x0 0x0 0x28 0x1 0x0 0x0 0x1 0x1 0x0 0x29 0x0 0x0 0x0 0x1 0x1 0x0 0x2a 0x0 0x1 0x0 0x0 0x0 0x0 0x2b 0x1 0x1 0x0 0x0 0x0 0x0 0x2c 0x0 0x0 0x0 0x1 0x0 0x0 0x2d 0x0 0x0 0x0 0x1 0x0 0x0 0x2e 0x0 0x0 0x0 0x1 0x0 0x0 0x2f 0x1 0x0 0x0 0x1 0x1 0x0 0x30 0x1 0x0 0x0 0x1 0x1 0x0 0x31 0x1 0x0 0x0 0x1 0x1 0x0 0x32 0x0 0x1 0x0 0x1 0x0 0x0 0x33 0x0 0x1 0x0 0x1 0x0 0x0 0x34 0x0 0x0 0x0 0x1 0x0 0x0 0x35 0x0 0x1 0x0 0x0 0x0 0x0 0x36 0x0 0x0 0x0 0x1 0x0 0x0 0x37 0x0 0x1 0x0 0x1 0x0 0x0 0x38 0x0 0x1 0x0 0x1 0x0 0x0 0x39 0x0 0x0 0x0 0x1 0x0 0x0 0x3a 0x0 0x0 0x0 0x1 0x0 0x0 0x3b 0x1 0x0 0x0 0x1 0x0 0x0 0x3c 0x1 0x0 0x0 0x1 0x0 0x0 0x3d 0x1 0x0 0x0 0x1 0x0 0x0 0x3e 0x1 0x0 0x0 0x1 0x0 0x0 0x3f 0x1 0x0 0x0 0x1 0x0 0x0 0x40 0x1 0x0 0x0 0x1 0x0 0x0 0x41 0x0 0x0 0x0 0x1 0x0 0x0 0x42 0x0 0x0 0x0 0x1 0x0 0x0 0x43 0x1 0x0 0x0 0x1 0x0 0x0 0x44 0x1 0x0 0x0 0x1 0x0 0x0 0x45 0x0 0x0 0x0 0x1 0x0 0x0 0x46 0x1 0x1 0x0 0x1 0x0 0x0 0x47 0x1 0x1 0x0 0x1 0x0 0x0 0x48 0x1 0x1 0x0 0x1 0x0 0x0 0x49 0x1 0x1 0x0 0x1 0x0 0x0 0x4a 0x1 0x0 0x0 0x1 0x0 0x0 0x4b 0x1 0x0 0x0 0x1 0x0 0x0 0x4c 0x1 0x1 0x0 0x1 0x0 0x0 0x4d 0x0 0x0 0x0 0x1 0x0 0x0 0x4e 0x0 0x0 0x0 0x1 0x0 0x0 0x4f 0x0 0x0 0x0 0x1 0x0 0x0 0x50 0x0 0x0 0x0 0x1 0x0 0x0 0x51 0x1 0x0 0x0 0x1 0x1 0x0 0x52 0x1 0x0 0x0 0x1 0x1 0x0 0x53 0x1 0x0 0x0 0x1 0x1 0x0 0x54 0x1 0x0 0x0 0x1 0x1 0x0 0x55 0x0 0x0 0x0 0x1 0x0 0x0 0x56 0x0 0x0 0x0 0x1 0x0 0x0 0x57 0x0 0x0 0x0 0x1 0x0 0x0 0x58 0x0 0x0 0x0 0x1 0x0 0x0 0x59 0x0 0x0 0x0 0x1 0x0 0x0 0x5a 0x0 0x0 0x0 0x1 0x0 0x0 0x5b 0x0 0x0 0x0 0x1 0x0 0x0 0x5c 0x1 0x1 0x0 0x1 0x0 0x0 0x5d 0x1 0x0 0x0 0x1 0x1 0x0 0x5e 0x0 0x0 0x0 0x1 0x0 0x0 0x5f 0x1 0x0 0x0 0x1 0x1 0x0 0x60 0x1 0x1 0x0 0x0 0x0 0x0 0x61 0x0 0x1 0x0 0x0 0x0 0x0 0x62 0x0 0x0 0x0 0x1 0x0 0x0 0x63 0x0 0x1 0x0 0x0 0x0 0x0 0x64 0x0 0x0 0x0 0x1 0x0 0x0 0x65 0x0 0x1 0x1 0x0 0x0 0x0 0x66 0x0 0x0 0x0 0x1 0x0 0x0 0x67 0x1 0x0 0x0 0x1 0x1 0x0 0x68 0x1 0x0 0x0 0x1 0x1 0x0 0x69 0x1 0x0 0x0 0x1 0x1 0x0 0x6a 0x1 0x0 0x0 0x1 0x1 0x0 0x6b 0x0 0x0 0x0 0x1 0x0 0x0 0x6c 0x0 0x0 0x0 0x1 0x0 0x0 0x6d 0x0 0x0 0x0 0x1 0x0 0x0 0x6e 0x0 0x0 0x0 0x1 0x0 0x0 0x6f 0x0 0x0 0x0 0x1 0x0 0x0 0x70 0x0 0x0 0x0 0x1 0x0 0x0 0x71 0x1 0x0 0x0 0x1 0x0 0x0 0x72 0x1 0x0 0x0 0x1 0x0 0x0 0x73 0x1 0x0 0x0 0x1 0x0 0x0 0x74 0x1 0x0 0x0 0x1 0x0 0x0 0x75 0x1 0x0 0x0 0x1 0x0 0x0 0x76 0x1 0x0 0x0 0x1 0x0 0x0 0x77 0x1 0x0 0x0 0x1 0x0 0x0 0x78 0x1 0x0 0x0 0x1 0x0 0x0 0x79 0x1 0x0 0x0 0x1 0x0 0x0 0x7a 0x1 0x0 0x0 0x1 0x1 0x0 0x7b 0x1 0x0 0x0 0x1 0x1 0x0 0x7c 0x1 0x1 0x0 0x0 0x0 0x0 0x7d 0x1 0x0 0x0 0x1 0x1 0x0 0x7e 0x1 0x0 0x0 0x1 0x1 0x0 0x7f 0x1 0x0 0x0 0x1 0x1 0x0 0x80 0x1 0x0 0x0 0x1 0x1 0x0 0x81 0x1 0x0 0x0 0x1 0x1 0x0 0x82 0x1 0x0 0x0 0x1 0x1 0x0 0x83 0x1 0x0 0x0 0x1 0x0 0x0 0x84 0x1 0x0 0x0 0x1 0x1 0x0 0x85 0x1 0x1 0x1 0x0 0x0 0x0 0x86 0x1 0x0 0x0 0x1 0x0 0x0 0x87 0x1 0x1 0x0 0x0 0x0 0x0 0x88 0x1 0x1 0x0 0x1 0x0 0x0 0x89 0x1 0x1 0x0 0x1 0x0 0x0 0x8a 0x1 0x1 0x0 0x0 0x0 0x0 0x8b 0x1 0x1 0x0 0x1 0x0 0x0 0x8c 0x1 0x0 0x0 0x0 0x0 0x0 0x8d 0x1 0x0 0x0 0x0 0x0 0x0 0x8e 0x1 0x0 0x0 0x0 0x0 0x0 0x8f 0x1 0x0 0x0 0x0 0x0 0x0 0x90 0x1 0x0 0x0 0x1 0x0 0x0 0x91 0x1 0x1 0x1 0x0 0x0 0x0 0x92 0x1 0x0 0x0 0x1 0x0 0x0 0x93 0x1 0x1 0x0 0x0 0x0 0x0 0x94 0x1 0x1 0x0 0x0 0x0 0x0 0x95 0x1 0x1 0x0 0x0 0x0 0x0 0x96 0x0 0x0 0x0 0x1 0x0 0x0 0x97 0x0 0x0 0x0 0x1 0x0 0x0 0x98 0x0 0x1 0x0 0x0 0x0 0x0 0x99 0x0 0x0 0x0 0x1 0x0 0x0 0x9a 0x1 0x1 0x0 0x0 0x0 0x0 0x9b 0x0 0x0 0x0 0x1 0x0 0x0 0x9c 0x0 0x0 0x0 0x1 0x0 0x0 0x9d 0x0 0x0 0x0 0x1 0x0 0x0 0x9e 0x0 0x1 0x0 0x0 0x0 0x0 0x9f 0x0 0x0 0x0 0x1 0x1 0x0 0xa0 0x0 0x0 0x0 0x1 0x1 0x0 0xa1 0x0 0x0 0x0 0x1 0x0 0x0 0xa2 0x0 0x0 0x0 0x1 0x0 0x0 0xa3 0x0 0x0 0x0 0x1 0x0 0x0 0xa4 0x0 0x0 0x0 0x1 0x0 0x0 0xa5 0x0 0x1 0x1 0x0 0x0 0x0 0xa6 0x0 0x0 0x0 0x1 0x0 0x0 0xa7 0x1 0x1 0x0 0x1 0x0 0x0 0xa8 0x1 0x1 0x0 0x1 0x0 0x0 0xa9 0x0 0x0 0x0 0x1 0x0 0x0 0xaa 0x1 0x0 0x0 0x1 0x0 0x0 0xab 0x1 0x0 0x0 0x1 0x0 0x0 0xac 0x1 0x0 0x0 0x1 0x0 0x0 0xad 0x0 0x0 0x0 0x1 0x0 0x0 0xae 0x0 0x0 0x0 0x1 0x0 0x0 0xaf 0x0 0x0 0x0 0x1 0x0 0x0 0xb0 0x0 0x0 0x0 0x1 0x0 0x0 0xb1 0x0 0x1 0x0 0x1 0x0 0x0 0xb2 0x0 0x0 0x0 0x1 0x0 0x0 0xb3 0x0 0x1 0x0 0x0 0x0 0x0 0xb4 0x0 0x0 0x0 0x1 0x0 0x0 0xb5 0x0 0x0 0x0 0x1 0x0 0x0 0xb6 0x0 0x0 0x0 0x1 0x0 0x0 0xb7 0x0 0x0 0x0 0x1 0x0 0x0 0xb8 0x0 0x0 0x0 0x1 0x0 0x0 0xb9 0x0 0x0 0x0 0x1 0x0 0x0 0xba 0x0 0x0 0x0 0x1 0x0 0x0 0xbb 0x0 0x0 0x0 0x1 0x0 0x0 0xbc 0x0 0x0 0x0 0x1 0x0 0x0 0xbd 0x0 0x0 0x0 0x1 0x0 0x0 0xbe 0x0 0x0 0x0 0x1 0x0 0x0 0xbf 0x0 0x0 0x0 0x1 0x0 0x0>;
		};
	};

	fragment@44 {
		target = <0xffffffff>;

		__overlay__ {
			deb-gpios = <0xffffffff 0x3 0x0>;
			debounce = <0x3e800>;
			interrupt-parent = <0xffffffff>;
			interrupts = <0x3 0x4 0x3 0x0>;
			status = "okay";
		};
	};

	fragment@45 {
		target = <0xffffffff>;

		__overlay__ {
			deb-gpios = <0xffffffff 0x7 0x0>;
			debounce = <0x3e800>;
			interrupt-parent = <0xffffffff>;
			interrupts = <0x7 0x8 0x7 0x0>;
			status = "okay";
		};
	};

	fragment@46 {
		target = <0xffffffff>;

		__overlay__ {
			interrupt-parent = <0xffffffff>;
			interrupts = <0x9 0x8 0x9 0x0>;
			status = "okay";
		};
	};

	fragment@47 {
		target = <0xffffffff>;

		__overlay__ {
			interrupt-parent = <0xffffffff>;
			interrupts = <0xa 0x8 0xa 0x0>;
			status = "okay";
		};
	};

	fragment@48 {
		target = <0xffffffff>;

		__overlay__ {
			interrupt-parent = <0xffffffff>;
			interrupts = <0x18 0x8 0x18 0x0>;
			status = "okay";
		};
	};

	fragment@49 {
		target = <0xffffffff>;

		__overlay__ {
			interrupt-parent = <0xffffffff>;
			interrupts = <0x29 0x8 0x29 0x0>;
			status = "okay";
		};
	};

	fragment@5 {
		target = <0xffffffff>;

		__overlay__ {
			ac_charger_current = <0x1e8480>;
			ac_charger_input_current = <0x1e8480>;
			algorithm_name = "SwitchCharging";
			chg1_ta_ac_charger_current = <0x1e8480>;
			chg2_ta_ac_charger_current = <0x1e8480>;
		};
	};

	fragment@50 {
		target = <0xffffffff>;

		__overlay__ {
			interrupt-parent = <0xffffffff>;
			interrupts = <0x2c 0x1 0x2c 0x0>;
			status = "okay";
		};
	};

	fragment@51 {
		target = <0xffffffff>;

		__overlay__ {
			interrupt-parent = <0xffffffff>;
			interrupts = <0xb6 0x4 0xbe 0x0>;
			status = "okay";
		};
	};

	fragment@52 {
		target = <0xffffffff>;

		__overlay__ {
			compatible = "mediatek,md1_sim1_hot_plug_eint-eint";
			debounce = <0x1 0x186a0>;
			dedicated = <0x1 0x0>;
			interrupts = <0x1 0x8>;
			sockettype = <0x1 0x0>;
			src_pin = <0x1 0x1>;
			status = "okay";
		};
	};

	fragment@53 {
		target = <0xffffffff>;

		__overlay__ {
			regulator-default-on = <0x1>;
			regulator-name = "vcama1";
			status = "okay";
		};
	};

	fragment@54 {
		target = <0xffffffff>;

		__overlay__ {
			regulator-default-on = <0x1>;
			regulator-name = "vcama2";
			status = "okay";
		};
	};

	fragment@55 {
		target = <0xffffffff>;

		__overlay__ {
			regulator-default-on = <0x1>;
			regulator-name = "vsim1";
			status = "okay";
		};
	};

	fragment@56 {
		target = <0xffffffff>;

		__overlay__ {
			regulator-default-on = <0x1>;
			regulator-name = "vsim2";
			status = "okay";
		};
	};

	fragment@57 {
		target = <0xffffffff>;

		__overlay__ {
			regulator-default-on = <0x1>;
			regulator-name = "vcamd";
			status = "okay";
		};
	};

	fragment@58 {
		target = <0xffffffff>;

		__overlay__ {
			regulator-default-on = <0x1>;
			regulator-name = "vcamio";
			status = "okay";
		};
	};

	fragment@59 {
		target = <0xffffffff>;

		__overlay__ {
			regulator-default-on = <0x1>;
			regulator-name = "vldo28";
			status = "okay";
		};
	};

	fragment@6 {
		target = <0xffffffff>;

		__overlay__ {
			atag,videolfb-fb_base_h = <0x0>;
			atag,videolfb-fb_base_l = "^`P";
			atag,videolfb-fps = <0x1770>;
			atag,videolfb-islcm_inited = <0x0>;
			atag,videolfb-islcmfound = <0x1>;
			atag,videolfb-lcmname = "es6311_anx6585_zigzag_wxga";
			atag,videolfb-vramSize = <0x17bb000>;
		};
	};

	fragment@60 {
		target = <0xffffffff>;

		__overlay__ {
			status = "okay";
			vcama-supply = <0xffffffff>;
			vcama_sub-supply = <0xffffffff>;
			vcamd-supply = <0xffffffff>;
			vcamd_sub-supply = <0xffffffff>;
			vcamio-supply = <0xffffffff>;
			vcamio_sub-supply = <0xffffffff>;
		};
	};

	fragment@61 {
		target = <0xffffffff>;

		__overlay__ {
			status = "okay";
			vtouch-supply = <0xffffffff>;
		};
	};

	fragment@62 {
		target = <0xffffffff>;

		__overlay__ {
			mediatek,kpd-hw-dl-key0 = <0x11>;
			mediatek,kpd-hw-dl-key1 = <0x0>;
			mediatek,kpd-hw-dl-key2 = <0x8>;
			mediatek,kpd-hw-factory-key = <0x0>;
			mediatek,kpd-hw-init-map = <0x72 0x0 0x0 0x0 0x0 0x0 0x0 0x0 0x0 0x0 0x0 0x0 0x0 0x0 0x0 0x0 0x0 0x0 0x0 0x0 0x0 0x0 0x0 0x0 0x0 0x0 0x0 0x0 0x0 0x0 0x0 0x0 0x0 0x0 0x0 0x0 0x0 0x0 0x0 0x0 0x0 0x0 0x0 0x0 0x0 0x0 0x0 0x0 0x0 0x0 0x0 0x0 0x0 0x0 0x0 0x0 0x0 0x0 0x0 0x0 0x0 0x0 0x0 0x0 0x0 0x0 0x0 0x0 0x0 0x0 0x0 0x0>;
			mediatek,kpd-hw-map-num = <0x48>;
			mediatek,kpd-hw-pwrkey = <0x8>;
			mediatek,kpd-hw-recovery-key = <0x11>;
			mediatek,kpd-hw-rstkey = <0x11>;
			mediatek,kpd-key-debounce = <0x400>;
			mediatek,kpd-pwkey-gpio-din = <0x0>;
			mediatek,kpd-pwrkey-eint-gpio = <0x0>;
			mediatek,kpd-sw-pwrkey = <0x74>;
			mediatek,kpd-sw-rstkey = <0x73>;
			mediatek,kpd-use-extend-type = <0x0>;
			status = "okay";
		};
	};

	fragment@7 {
		target = <0xffffffff>;

		__overlay__ {
			pinctrl-0 = <0x18>;
			pinctrl-1 = <0x19>;
			pinctrl-2 = <0x1a>;
			pinctrl-3 = <0x1b>;
			pinctrl-names = "default", "gps_lna_state_init", "gps_lna_state_oh", "gps_lna_state_ol";
			status = "okay";
		};
	};

	fragment@8 {
		target = <0xffffffff>;

		__overlay__ {

			cap_touch@41 {
				compatible = "mediatek,cap_touch";
				int-gpio = <0xffffffff 0x1 0x0>;
				interrupt-parent = <0xffffffff>;
				interrupts = <0x1 0x1 0x1 0x0>;
				reg = <0x41>;
				rst-gpio = <0xffffffff 0x9e 0x0>;
				status = "okay";
			};

			focaltech_touch@38 {
				compatible = "mediatek,focaltech_touch";
				interrupt-parent = <0xffffffff>;
				interrupts = <0x1 0x1 0x1 0x0>;
				reg = <0x38>;
				status = "okay";
			};

			goodix_touch@5e {
				compatible = "mediatek,goodix_touch";
				interrupt-parent = <0xffffffff>;
				interrupts = <0x1 0x1 0x1 0x0>;
				reg = <0x5e>;
				reg-tp-supply = <0xffffffff>;
				status = "okay";
			};

			himax_touch@48 {
				compatible = "mediatek,himax_touch";
				debounce = <0x1 0x0>;
				interrupt-parent = <0xffffffff>;
				interrupts = <0x1 0x1 0x1 0x0>;
				reg = <0x48>;
				status = "okay";
			};

			silead_touch@40 {
				compatible = "mediatek,silead_touch";
				interrupt-parent = <0xffffffff>;
				interrupts = <0x1 0x1 0x1 0x0>;
				reg = <0x40>;
				reg-tp-supply = <0xffffffff>;
				status = "okay";
			};
		};
	};

	fragment@9 {
		target = <0xffffffff>;

		__overlay__ {

			alsps@49 {
				compatible = "mediatek,alsps";
				debounce = <0x6 0x0>;
				em3071x_addr = <0x24 0x0 0x0 0x0>;
				em3071x_level = <0xa 0x50 0xa0 0xf0 0x190 0x230 0x2bc 0x384 0x44c 0x514 0x5dc 0x93c 0xbb8 0x122f 0x1b46>;
				em3071x_thld_high = <0x6a4>;
				em3071x_thld_low = <0x5dc>;
				em3071x_value = <0x0 0x50 0xa0 0x104 0x1c2 0x258 0x2ee 0x3e8 0x4e2 0x5aa 0x6a4 0xa28 0xce4 0x1400 0x1e00 0x2800>;
				epl259x_addr = <0x49 0x0 0x0 0x0>;
				epl259x_level = <0x14 0x2d 0x46 0x5a 0x96 0x12c 0x1f4 0x2bc 0x47e 0x8ca 0x1194 0x1f40 0x3a98 0x7530 0xc350>;
				epl259x_thld_high = <0x320>;
				epl259x_thld_low = <0x1f4>;
				epl259x_value = <0xa 0x1e 0x3c 0x50 0x64 0xc8 0x190 0x258 0x320 0x5dc 0xbb8 0x1770 0x2710 0x4e20 0x9c40 0xea60>;
				firlen = <0x10>;
				i2c_num = <0x1>;
				interrupt-parent = <0xffffffff>;
				interrupts = <0x6 0x8 0x6 0x0>;
				is_batch_supported = <0x0>;
				is_batch_supported_als = <0x0>;
				is_batch_supported_ps = <0x0>;
				pinctrl-0 = <0x1c>;
				pinctrl-1 = <0x1d>;
				pinctrl-names = "pin_default", "pin_cfg";
				polling_mode_als = <0x1>;
				polling_mode_ps = <0x0>;
				power_id = <0xffff>;
				power_vol = <0x0>;
				reg = <0x49>;
				status = "okay";
				stk3x1x_addr = <0x48 0x0 0x0 0x0>;
				stk3x1x_level = <0x5 0x9 0x24 0x3b 0x52 0x84 0xcd 0x111 0x1f4 0x34d 0x470 0x609 0x93c 0x122f 0x1b46>;
				stk3x1x_thld_high = <0x6a4>;
				stk3x1x_thld_low = <0x5dc>;
				stk3x1x_value = <0x1e 0x28 0x50 0x82 0xb4 0x122 0x1c2 0x258 0x44c 0x744 0x9c4 0xd48 0x1450 0x2800 0x2800 0x2800>;
				stk3x3x_addr = <0x57 0x0 0x0 0x0>;
				stk3x3x_level = <0xa 0x50 0xa0 0xf0 0x190 0x230 0x2bc 0x384 0x44c 0x514 0x5dc 0x93c 0xbb8 0x122f 0x1b46>;
				stk3x3x_thld_high = <0x6a4>;
				stk3x3x_thld_low = <0x5dc>;
				stk3x3x_value = <0x0 0x50 0xa0 0x104 0x1c2 0x258 0x2ee 0x3e8 0x4e2 0x5aa 0x6a4 0xa28 0xce4 0x1400 0x1e00 0x2800>;
			};

			gsensor@18 {
				bma222e_addr = <0x18 0x0 0x0 0x0>;
				bma222e_direction = <0x0>;
				compatible = "mediatek,gsensor";
				firlen = <0x10>;
				i2c_num = <0x2>;
				icm426xx_a_addr = <0x68 0x0 0x0 0x0>;
				icm426xx_a_direction = <0x0>;
				is_batch_supported = <0x0>;
				mc34xx_addr = <0x4c 0x0 0x0 0x0>;
				mc34xx_direction = <0x0>;
				mpu6050g_addr = <0x68 0x0 0x0 0x0>;
				mpu6050g_direction = <0x0>;
				mxc665x_addr = <0x15 0x0 0x0 0x0>;
				mxc665x_direction = <0x3>;
				power_id = <0xffff>;
				power_vol = <0x0>;
				reg = <0x18>;
				status = "okay";
				stk8baxx_addr = <0x18 0x0 0x0 0x0>;
				stk8baxx_direction = <0x3>;
			};

			gyro@68 {
				compatible = "mediatek,gyro";
				firlen = <0x0>;
				i2c_num = <0x2>;
				icm426xx_g_addr = <0x68 0x0 0x0 0x0>;
				icm426xx_g_direction = <0x0>;
				is_batch_supported = <0x0>;
				mpu6050gy_addr = <0x68 0x0 0x0 0x0>;
				mpu6050gy_direction = <0x0>;
				power_id = <0xffff>;
				power_vol = <0x0>;
				reg = <0x68>;
				status = "okay";
			};

			msensor@30 {
				compatible = "mediatek,msensor";
				i2c_num = <0x2>;
				is_batch_supported = <0x0>;
				mmc3416x_addr = <0x30 0x0 0x0 0x0>;
				mmc3416x_direction = <0x2>;
				mmc3630x_addr = <0x30 0x0 0x0 0x0>;
				mmc3630x_direction = <0x2>;
				power_id = <0xffff>;
				power_vol = <0x0>;
				reg = <0x30>;
				status = "disabled";
			};
		};
	};
};
